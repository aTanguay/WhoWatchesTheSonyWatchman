## sdkconfig.defaults
```kconfig
# ESP32 Configuration Defaults for Sony Watchman

# CPU Frequency - 240MHz for best video performance
CONFIG_ESP_DEFAULT_CPU_FREQ_MHZ_240=y

# Flash size
CONFIG_ESPTOOLPY_FLASHSIZE_4MB=y

# Partition table - custom for OTA support (future)
CONFIG_PARTITION_TABLE_SINGLE_APP=y

# FreeRTOS optimizations
CONFIG_FREERTOS_HZ=1000
CONFIG_FREERTOS_USE_TICKLESS_IDLE=y

# Memory optimization
CONFIG_ESP_SYSTEM_EVENT_TASK_STACK_SIZE=4096
CONFIG_ESP_MAIN_TASK_STACK_SIZE=8192

# SPI optimizations for SD card and display
CONFIG_SPI_MASTER_ISR_IN_IRAM=y

# FAT filesystem support for SD card
CONFIG_FATFS_LFN_HEAP=y
CONFIG_FATFS_MAX_LFN=255

# Compiler optimizations
CONFIG_COMPILER_OPTIMIZATION_PERF=y
CONFIG_COMPILER_OPTIMIZATION_ASSERTIONS_DISABLE=y

# Disable unused components to save flash/RAM
CONFIG_BT_ENABLED=n
CONFIG_WIFI_ENABLED=n

# Enable PSRAM if using ESP32-WROVER or ESP32-S3
# CONFIG_SPIRAM=y
# CONFIG_SPIRAM_SPEED_80M=y
# CONFIG_SPIRAM_USE_MALLOC=y
```
